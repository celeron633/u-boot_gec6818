## arch/arm/mach-nexell/Kconfig
```kconfig
if ARCH_NEXELL

config NEXELL_COMMON
	bool "Nexell common options"

config NEXELL_ARMV7_COMMON
	bool "Nexell 32-bit common options"
	select CPU_V7
	select NEXELL_COMMON
	select SUPPORT_SPL

config NEXELL_ARMV8_COMMON
	bool "Nexell 64-bit common options"
	select ARM64
	select ARMV8_MULTIENTRY
	select NEXELL_COMMON

config S5P6818_AARCH32
	bool "Build for S5P6818 running in AArch32"
	help
	  32-bit u-boot for the S5P6818: the Cortex-A53 cores stay in
	  AArch32 (secure SVC) as BL1 leaves them, e.g. to boot an old
	  32-bit kernel. Needs a BL1 built with OPMODE=aarch32 UBOOT_ARCH=aarch32.

choice
	prompt "Nexell SoC select"
	optional

config ARCH_S5P4418
	bool "Nexell S5P4418 family"
	select NEXELL_ARMV7_COMMON

config ARCH_S5P6818
	bool "Nexell S5P6818 family"
	select NEXELL_ARMV8_COMMON if !S5P6818_AARCH32
	select NEXELL_ARMV7_COMMON if S5P6818_AARCH32

endchoice

config CPU_NXP4330
	bool "Nexell NXP4330 CPU"
	depends on ARCH_S5P4418

if ARCH_S5P4418
menu "Board for S5P4418"
source "board/s5p4418/Kconfig"
endmenu
endif

if ARCH_S5P6818
menu "Board for S5P6818"
source "board/s5p6818/Kconfig"
endmenu
endif

config SYS_SOC
	default "nexell"

endif
```
